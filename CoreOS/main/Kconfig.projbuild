## CoreOS/main/Kconfig.projbuild
```kconfig
menu "PURR OS"

    choice PURR_UI_BACKEND
        prompt "UI Backend"
        default PURR_UI_BACKEND_KITTENUI
        help
            Select the windowing system for this device. All UI modules are
            compiled into every firmware; only the selected one is activated.

        config PURR_UI_BACKEND_KITTENUI
            bool "KittenUI (LVGL 8)"
            help
                KittenUI uses LVGL for rich touch-based UI. Best for devices
                with sufficient RAM and a colour touchscreen.

        config PURR_UI_BACKEND_MINIWIN
            bool "MiniWin"
            help
                MiniWin is a lightweight windowing system for smaller devices
                or when LVGL's footprint is unwanted.

        config PURR_UI_BACKEND_OLED
            bool "OLED UI (headless/SSD1306)"
            help
                Minimal OLED UI for devices with monochrome displays or
                no display at all.

        config PURR_UI_BACKEND_BLACKPURR
            bool "BlackPURR (LVGL 8, dark hybrid UI)"
            help
                BlackPURR is the PURR OS flagship UI shell — dark theme, icon
                ribbon + app drawer inspired by BlackBerry OS 6/7. Supports
                hybrid touch/trackball input, software cursor overlay for
                legacy apps. Requires LVGL 8. Best on T-Deck Plus.

        config PURR_UI_BACKEND_CARDSTACK
            bool "Cardstack (LVGL 8, Rabbit R1-style card stack)"
            help
                Vertical snap-scrolling card stack — one full-screen card per
                app, home card (clock/wallpaper/notifications) first, an
                end-of-stack Task Manager card last. Two-stage drag-down
                status bar (peek, then full notification center) and a
                left-edge swipe back to Home from inside any app. Requires
                LVGL 8 and the kernel notification API (PURR_KERNEL_VERSION
                >= 1.0.0).

        config PURR_UI_BACKEND_CUPCAKE
            bool "Cupcake (LVGL 8, Android 1.5-style launcher)"
            help
                Android 1.5 ("Cupcake")-style launcher: a home screen with a
                small number of pinned app shortcuts plus a bottom dock, and
                a separate all-apps drawer (opened from the dock's center
                button) showing every registered app in a scrollable grid.
                Status bar + drag-down notification panel forked from
                Cardstack. Requires LVGL 8 and the kernel notification API.

        config PURR_UI_BACKEND_LVGLDEBUG
            bool "LVGL Debug (touch/HAL diagnostics)"
            help
                Minimal LVGL screen for diagnosing touch mapping: shows live
                raw + mapped coordinates as text and draws a dot exactly
                where a tap is detected, so misalignment is visible
                immediately instead of read from serial logs. Not a real
                desktop shell — purely a debugging tool.

        config PURR_UI_BACKEND_POUNCE
            bool "Pounce (raw framebuffer, keyboard+trackball-first)"
            help
                Direct-to-panel immediate-mode UI backend — no LVGL, no
                vendored MiniWin. Implements the full catcall_ui_t/purr_win_t
                contract (every system app runs unmodified) with its own
                small widget model, synchronous redraw at the mutation call
                site (no dirty-flag scan), and a genuinely new
                keyboard/trackball widget-to-widget focus-navigation system —
                nothing else in this codebase has one. A full-screen modal
                window stack only, no overlapping/floating chrome. Built for
                physical-keyboard + trackball devices (T-Deck/T-Deck Plus);
                touch is optional/secondary. See pounce_plan.md at the repo
                root for the full design. EXPERIMENTAL — landing opt-in via
                the tdeck_plus_pounce device, not the default tdeck_plus.

    endchoice

    config PURR_UI_WINCE_SHELL
        bool "WinCE shell baked directly into kernel (no .purr module wrapper)"
        default n
        depends on PURR_UI_BACKEND_MINIWIN
        help
            For devices that bake the WinCE-style shell (ported from PURR OS
            0.11) directly into their specialized kernel instead of using
            MiniWin's own desktop module. Tells miniwin_module.c to skip
            starting its own desktop/task since the kernel already started
            its own.

    config PURR_MINIWIN_DESKTOP_WINCE
        bool "MiniWin: WinCE-style desktop (taskbar + start menu) [EXPERIMENTAL]"
        default y
        depends on PURR_UI_BACKEND_MINIWIN && !PURR_UI_WINCE_SHELL
        help
            Default desktop for any MiniWin device now (was opt-in per-device
            via a manual sdkconfig override) — Cupcake is parked as a
            work-in-progress pending an unresolved app-window-visibility bug,
            so this is the active default UI direction project-wide.
            Generalized version of the WinCE-style taskbar/start-menu chrome
            (see miniwin_wince_desktop.c) for any native-kernel MiniWin
            device — replaces the default icon-grid desktop. The Start
            Menu's Programs list is built from the real app_manager
            registry, and every purr_win_create() window gets a taskbar
            button automatically. Mutually exclusive with PURR_UI_WINCE_SHELL,
            which is for kernels that bake their own shell in directly instead
            of using this module.

            Known-rough edges as of introduction: apps launch in their own
            FreeRTOS task via app_manager, so any UI backend's own render
            task loop must serialize against that with purr_kernel_ui_lock()
            or risk racing the display driver. Build-time opt-in only for
            now — see docs/01_Architecture.md.

    config PURR_DISPLAY_ST7789_BGR_ORDER
        bool "ST7789: panel is physically wired BGR, not RGB"
        default n
        help
            The ST7789 driver's MADCTL register (source/drivers/display/
            st7789/st7789.c) hardcodes RGB colour order for every device that
            uses it (tdeck, tdeck_plus, waveshare169). Some panel batches are
            physically wired BGR internally, which shows up as every colour's
            red and blue channels swapped on screen — confirmed live on
            tdeck_plus's MiniWin WinCE desktop: the teal wallpaper
            (WCE_DESKTOP = 0x008080) rendered as a dark olive-yellow
            (0x808000, R/B swapped), and a focused app window's title bar
            colour (MW_TITLE_BAR_COLOUR_FOCUS = MW_HAL_LCD_BLUE = 0x0000FF)
            rendered as exactly MW_HAL_LCD_RED (0xFF0000) — not approximately
            red, the identical named constant, which is the strongest single
            piece of evidence this is a channel swap and not some other
            colour bug.

            Ruled out before landing this: SPI byte-order (already correct,
            st7789_fill_rect()/push_pixels() byte-swap before transmission —
            see hal_lcd.c's own comment on a prior, different, already-fixed
            double-swap bug), software RGB math in the vendored MiniWin gl.c
            (checked, standard/correct shifts), and panel inversion (ST_INVON
            is already correctly enabled from an earlier fix, an orthogonal
            setting from channel order).

            Enabling this ORs the MADCTL RGB/BGR order bit (0x08) into the
            register value st7789.c already computes. Left off by default
            since this may be a wiring quirk specific to one panel batch
            rather than universal to every ST7789 device this driver serves
            — opt in per-device (see CoreOS/sdkconfig_tdeck_plus.overrides)
            rather than risking a regression on tdeck/waveshare169, which
            haven't reported this symptom and aren't part of active hardware
            testing right now.

    config PURR_FEATURE_MESHTASTIC
        bool "Meshtastic-compatible mesh module"
        default n
        help
            Gates source/modules/meshtastic/ (mesh_router.c, mesh_radio.c,
            and the real half of meshtastic_module.c) — off by default on
            every device. When off, meshtastic_module.c compiles to a stub
            implementation of every function meshtastic.h declares
            (mesh_manager_send_text() etc. return false/0), so callers like
            MeshChat (meshchat.c) keep compiling and linking unchanged —
            its buddy list just shows 0 nodes and sends silently no-op,
            rather than the app being removed. mesh_router.c/mesh_radio.c
            have no external callers and compile to an empty translation
            unit when this is off.

            Same shape as CONFIG_BT_NIMBLE_ENABLED's existing bt_mgr.c
            guard (a real Kconfig toggle, not just a device.pcat
            registration entry — components under source/modules/ compile
            into every device's firmware regardless of device.pcat's
            [modules] section, so only a compile-time #ifdef actually saves
            the static footprint on devices that don't want this feature).

            Devices with real LoRa + antenna hardware provisioned for mesh
            opt in via their own .overrides file, same pattern as
            PURR_DISPLAY_ST7789_BGR_ORDER above.

    config PURR_TDECK_PLUS_PHYSICAL_KEYBOARD
        bool "T-Deck Plus: init physical BBQ20 keyboard"
        default y
        help
            Disable to skip BBQ20 I2C keyboard init entirely and rely solely
            on the on-screen keyboard (Cupcake's purr_win_keyboard_show()) —
            useful for bring-up/testing without the physical keyboard
            attached. Previously there was no way to disable this at all —
            bbq20_drv_init() was unconditionally hardcoded into
            kernel_tdp_boot.c.

    # arduino-esp32 3.3.10's own USB.cpp/USBCDC.cpp/USBMSC.cpp/
    # esp32-hal-tinyusb.h (source/modules/usb_msc pulls arduino-esp32 in
    # transitively — see CoreOS/main/idf_component.yml) gate their entire
    # bodies behind `#if CONFIG_TINYUSB_ENABLED`, including the #include of
    # tusb.h/tusb_config.h itself — but arduino-esp32 never defines this
    # symbol anywhere in its own Kconfig, and neither does espressif/
    # esp_tinyusb (which uses TINYUSB_CDC_ENABLED/TINYUSB_MSC_ENABLED, no
    # master switch) or ESP-IDF's own "usb" component on IDF < 6.0.
    # Confirmed live: without this, CFG_TUD_CDC/tud_cdc_n_write/etc. are
    # simply never declared, since the #include that would pull them in
    # never runs — arduino-esp32's USB support appears to assume either
    # IDF >= 6.0 (whose "usb" component reportedly defines this itself) or
    # some other pairing this project doesn't have. Defined here, tied to
    # esp_tinyusb's own feature flags rather than as a separate manual
    # toggle, so it's automatically on exactly when source/modules/usb_msc
    # needs it and off (matching every device's previous behavior) everywhere
    # else.
    config TINYUSB_ENABLED
        bool
        default y if TINYUSB_CDC_ENABLED || TINYUSB_MSC_ENABLED
        default n

endmenu
```

## CoreOS/sdkconfig.defaults
```kconfig
# PURR OS — LilyGo T-Deck Plus (ESP32-S3R8, ST7789 320x240, GT911 cap touch)
# 16MB flash, 8MB OPI PSRAM, built-in keyboard (HID), optional GPS

# Flash: 16MB, 80MHz, DIO
CONFIG_ESPTOOLPY_FLASHSIZE_16MB=y
CONFIG_ESPTOOLPY_FLASHFREQ_80M=y
CONFIG_ESPTOOLPY_FLASHMODE_DIO=y

# Partition table
CONFIG_PARTITION_TABLE_CUSTOM=y
CONFIG_PARTITION_TABLE_CUSTOM_FILENAME="partitions_tdeck_plus.csv"
CONFIG_PARTITION_TABLE_OFFSET=0x8000

# Arduino-ESP32
CONFIG_FREERTOS_HZ=1000

# CPU: 240MHz (ESP32-S3)
CONFIG_ESP32S3_DEFAULT_CPU_FREQ_240=y

# PSRAM: 8MB OPI (ESP32-S3R8)
CONFIG_SPIRAM=y
CONFIG_SPIRAM_MODE_OCT=y
CONFIG_SPIRAM_SPEED_80M=y
CONFIG_SPIRAM_BOOT_INIT=y
CONFIG_SPIRAM_ALLOW_BSS_SEG_EXTERNAL_MEMORY=y
# Route heap allocations ≥16KB to PSRAM; keep 32KB internal for DMA
CONFIG_SPIRAM_USE_MALLOC=y
CONFIG_SPIRAM_MALLOC_ALWAYSINTERNALL=16384
CONFIG_SPIRAM_MALLOC_RESERVE_INTERNAL=32768

# Logging
CONFIG_LOG_DEFAULT_LEVEL_INFO=y

# SPIFFS
CONFIG_SPIFFS_MAX_PARTITIONS=3

# FatFS (SD card)
CONFIG_FATFS_LFN_HEAP=y
CONFIG_FATFS_MAX_LFN=255
CONFIG_FATFS_SECTOR_512=y

# USB: native USB-Serial/JTAG on ESP32-S3 (used for console + shell)
# This routes ESP_LOG and printf to the USB-C port without needing a UART adapter.
CONFIG_ESP_CONSOLE_USB_SERIAL_JTAG=y
CONFIG_ESP_CONSOLE_SECONDARY_NONE=y
```
