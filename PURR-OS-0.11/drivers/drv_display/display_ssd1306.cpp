#include "display_ssd1306.h"
#include "driver/i2c_master.h"
#include "driver/gpio.h"
#include "esp_log.h"
#include "freertos/FreeRTOS.h"
#include "freertos/task.h"
#include <string.h>

// SSD1306 128×64 driver — IDF i2c_master, no Arduino/Wire dependency.
// Font: 6×8 (cols), 95 printable ASCII characters (0x20–0x7E).

static i2c_master_bus_handle_t s_bus = NULL;
static i2c_master_dev_handle_t s_dev = NULL;

#define SSD1306_ADDR    0x3C
#define SSD1306_CMD     0x00
#define SSD1306_DATA    0x40

// ── Embedded 6×8 font (95 chars, 0x20–0x7E) ──────────────────────────────────
// Each character: 6 columns of 8 pixels (LSB = top row).
// Column 6 is always 0 (spacing). Only 5 data columns stored; we pad one.
static const uint8_t FONT6x8[95][5] = {
    {0x00,0x00,0x00,0x00,0x00}, // ' '
    {0x00,0x00,0x5F,0x00,0x00}, // '!'
    {0x00,0x07,0x00,0x07,0x00}, // '"'
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    {0x10,0x08,0x08,0x10,0x08}, // '~'
};

// ── Framebuffer (128×64 / 8 = 1024 bytes) ────────────────────────────────────
static uint8_t s_fb[1024];
static bool    s_ok = false;

static void ssd_write(uint8_t type, const uint8_t* data, size_t len) {
    if (!s_dev) return;
    uint8_t buf[len + 1];
    buf[0] = type;
    memcpy(buf + 1, data, len);
    i2c_master_transmit(s_dev, buf, len + 1, 20);
}

static void ssd_cmd(uint8_t c) {
    ssd_write(SSD1306_CMD, &c, 1);
}

static void ssd_cmd2(uint8_t c0, uint8_t c1) {
    uint8_t d[2] = {c0, c1};
    ssd_write(SSD1306_CMD, d, 2);
}

static void ssd_cmd3(uint8_t c0, uint8_t c1, uint8_t c2) {
    uint8_t d[3] = {c0, c1, c2};
    ssd_write(SSD1306_CMD, d, 3);
}

static void ssd_flush() {
    ssd_cmd3(0x21, 0x00, 0x7F);
    ssd_cmd3(0x22, 0x00, 0x07);
    for (int i = 0; i < 1024; i += 16)
        ssd_write(SSD1306_DATA, &s_fb[i], 16);
}

static void fb_draw_char(int col, int row, char c) {
    if (c < 0x20 || c > 0x7E) c = ' ';
    const uint8_t* glyph = FONT6x8[(uint8_t)c - 0x20];
    int x = col * 6;
    for (int i = 0; i < 5; i++) {
        if (x + i < 128)
            s_fb[row * 128 + x + i] = glyph[i];
    }
    if (x + 5 < 128)
        s_fb[row * 128 + x + 5] = 0x00; // spacing column
}

static void fb_clear_row(int row) {
    memset(&s_fb[row * 128], 0, 128);
}

// ── Init sequence ─────────────────────────────────────────────────────────────
void display_ssd1306_init() {
    i2c_master_bus_config_t bus_cfg = {
        .i2c_port      = I2C_NUM_0,
        .sda_io_num    = (gpio_num_t)OLED_SDA,
        .scl_io_num    = (gpio_num_t)OLED_SCL,
        .clk_source    = I2C_CLK_SRC_DEFAULT,
        .glitch_ignore_cnt = 7,
        .flags = { .enable_internal_pullup = true },
    };
    i2c_new_master_bus(&bus_cfg, &s_bus);

    i2c_device_config_t dev_cfg = {
        .dev_addr_length = I2C_ADDR_BIT_LEN_7,
        .device_address  = SSD1306_ADDR,
        .scl_speed_hz    = 400000,
    };
    i2c_master_bus_add_device(s_bus, &dev_cfg, &s_dev);

    if (OLED_RST >= 0) {
        gpio_set_direction((gpio_num_t)OLED_RST, GPIO_MODE_OUTPUT);
        gpio_set_level((gpio_num_t)OLED_RST, 0); vTaskDelay(pdMS_TO_TICKS(10));
        gpio_set_level((gpio_num_t)OLED_RST, 1); vTaskDelay(pdMS_TO_TICKS(10));
    }

    // Probe — try a dummy write
    uint8_t probe = 0xAE;
    if (i2c_master_transmit(s_dev, &probe, 1, 20) != ESP_OK) {
        ESP_LOGE("ssd1306", "not found");
        return;
    }

    // Standard SSD1306 init sequence
    static const uint8_t INIT_SEQ[] = {
        0xAE,       // display off
        0xD5,0x80,  // clock divide / osc freq
        0xA8,0x3F,  // multiplex ratio (64-1)
        0xD3,0x00,  // display offset 0
        0x40,       // start line 0
        0x8D,0x14,  // charge pump enable
        0x20,0x00,  // horizontal addressing
        0xA1,       // seg remap (0xA0 = normal, 0xA1 = flip)
        0xC8,       // com scan direction (0xC0 = normal, 0xC8 = flip)
        0xDA,0x12,  // com pins
        0x81,0xCF,  // contrast
        0xD9,0xF1,  // pre-charge period
        0xDB,0x40,  // vcomh deselect
        0xA4,       // entire display on (resume RAM)
        0xA6,       // normal display (not inverted)
        0xAF,       // display on
    };
    for (size_t i = 0; i < sizeof(INIT_SEQ); ) {
        uint8_t cmd = INIT_SEQ[i++];
        ssd_cmd(cmd);
        // Commands with one parameter byte
        if (cmd == 0xD5 || cmd == 0xA8 || cmd == 0xD3 ||
            cmd == 0x8D || cmd == 0x20 || cmd == 0xDA ||
            cmd == 0x81 || cmd == 0xD9 || cmd == 0xDB)
            ssd_cmd(INIT_SEQ[i++]);
    }

    memset(s_fb, 0, sizeof(s_fb));
    ssd_flush();
    s_ok = true;
    ESP_LOGI("ssd1306", "OK 128x64");
}

void display_ssd1306_tick() {}

void display_ssd1306_deinit() {
    if (s_ok) { ssd_cmd(0xAE); s_ok = false; }
}

void display_ssd1306_text(uint8_t row, const char* text) {
    if (!s_ok || row >= 8) return;
    fb_clear_row(row);
    for (int i = 0; text[i] && i < 21; i++)
        fb_draw_char(i, row, text[i]);
    ssd_flush();
}

void display_ssd1306_clear() {
    if (!s_ok) return;
    memset(s_fb, 0, sizeof(s_fb));
    ssd_flush();
}

void display_ssd1306_set_cursor(uint8_t x, uint8_t y) { (void)x; (void)y; }
void display_ssd1306_print(const char* text) { (void)text; }

#include "purr_sys_drv.h"
static sys_drv_t s_ssd1306_drv = {
    .name="display:ssd1306",.subsystem="display",.enabled=false,
    .init=display_ssd1306_init,.tick=display_ssd1306_tick,.deinit=display_ssd1306_deinit,.cmd=NULL
};
void display_ssd1306_drv_register(bool enabled){s_ssd1306_drv.enabled=enabled;sys_drv_register(&s_ssd1306_drv);}
